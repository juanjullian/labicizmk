## boards/shields/labici/Kconfig.defconfig
```kconfig
# Copyright (c) 2020 The ZMK Contributors
# SPDX-License-Identifier: MIT
config SHIELD_LABICI
    bool "LA Bici Shield"
    select ZMK_KEYBOARD
```
